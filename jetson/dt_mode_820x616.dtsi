/*
 * Device-tree mode node for the 820x616 @ 85 fps IMX219 mode (JetPack 6, camera overlay of the carrier,
 * e.g. tegra234-p3767-camera-p3768-imx219-*.dts). Copy the existing 1640x1232 mode node of your overlay,
 * add it as the next modeN, and change only the fields marked CHANGED. The mode index must match the
 * position of imx219_mode_820x616_85fps in the driver's mode enum / table list.
 * NOT TESTED ON HARDWARE.
 */
mode5 { /* IMX219_MODE_820x616_85FPS */
	mclk_khz = "24000";
	num_lanes = "2";
	tegra_sinterface = "serial_a";        /* keep the value of your overlay */
	phy_mode = "DPHY";
	discontinuous_clk = "yes";
	dpcm_enable = "false";
	cil_settletime = "0";
	active_w = "820";                      /* CHANGED */
	active_h = "616";                      /* CHANGED */
	mode_type = "bayer";
	pixel_phase = "rggb";
	csi_pixel_bit_depth = "10";
	readout_orientation = "90";
	line_length = "3448";
	inherent_gain = "1";
	mclk_multiplier = "9.33";
	pix_clk_hz = "182400000";
	gain_factor = "16";
	framerate_factor = "1000000";
	exposure_factor = "1000000";
	min_gain_val = "16";
	max_gain_val = "170";
	step_gain_val = "1";
	default_gain = "16";
	min_hdr_ratio = "1";
	max_hdr_ratio = "1";
	min_framerate = "2000000";
	max_framerate = "85000000";            /* CHANGED: 85 fps */
	step_framerate = "1";
	default_framerate = "85000000";        /* CHANGED */
	min_exp_time = "13";
	max_exp_time = "11600";                /* CHANGED: exposure cannot exceed the frame time (us) */
	step_exp_time = "1";
	default_exp_time = "1500";             /* CHANGED: 1.5 ms fixed exposure (motion blur budget) */
	embedded_metadata_height = "2";
};
